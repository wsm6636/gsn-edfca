/*
 * Copyright 2015 Freescale Semiconductor, Inc.
 *
 * The code contained herein is licensed under the GNU General Public
 * License. You may obtain a copy of the GNU General Public License
 * Version 2 or later at the following locations:
 *
 * http://www.opensource.org/licenses/gpl-license.html
 * http://www.gnu.org/copyleft/gpl.html
 */

#include "imx6q-s2-sabresd.dts"

&backlights {
        pwms = <&pwm3 0 5000000>;
        status = "okay";
};

&mxcfb1 {
        compatible = "fsl,mxc_sdc_fb";
        disp_dev = "ldb";
        interface_pix_fmt = "RGB24";
        default_bpp = <16>;
        int_clk = <0>;
        late_init = <0>;
        status = "okay";
};
